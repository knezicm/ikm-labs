## meta-ikm/conf/distro/ikm.conf
```bitbake
# This distribution configuration is based of poky.conf
require conf/distro/poky.conf

DISTRO = "ikm"
DISTRO_NAME = "IKM (Industrijske Komunikacione Mreze)"
DISTRO_VERSION = "1.0.0"
DISTRO_CODENAME = "ikm"

# Setting systemd as init manager
INIT_MANAGER = "systemd"
DISTRO_FEATURES:append = " systemd"
VIRTUAL-RUNTIME_init_manager = "systemd"
DISTRO_FEATURES_BACKFILL_CONSIDERED = "sysvinit"
VIRTUAL-RUNTIME_initscripts = ""
```

## meta-ikm/conf/layer.conf
```bitbake
# We have a conf and classes directory, add to BBPATH
BBPATH .= ":${LAYERDIR}"

# We have recipes-* directories, add to BBFILES
BBFILES += "${LAYERDIR}/recipes-*/*/*.bb \
            ${LAYERDIR}/recipes-*/*/*.bbappend"

BBFILE_COLLECTIONS += "meta-ikm"
BBFILE_PATTERN_meta-ikm = "^${LAYERDIR}/"
BBFILE_PRIORITY_meta-ikm = "10"

LAYERDEPENDS_meta-ikm = "core"
LAYERSERIES_COMPAT_meta-ikm = "kirkstone"
```

## meta-ikm/conf/machine/raspberrypi3-ikm.conf
```bitbake
# This machine file is based of raspberry3.conf file
MACHINEOVERRIDES = "raspberrypi3:${MACHINE}" 
include conf/machine/raspberrypi3.conf

# UART support
ENABLE_UART = "1"
ENABLE_KGDB = "0"
CMDLINE_SERIAL = "console=tty1"

# SPI support
ENABLE_SPI_BUS = "1"

# I2C support
ENABLE_I2C = "1"

# Autoloading kernel modules
KERNEL_MODULE_AUTOLOAD:rpi += "i2c-dev i2c-bcm2708 sllin"

# Adding configuration for module
KERNEL_MODULE_PROBECONF:rpi = "sllin"
module_conf_sllin = "options sllin baudrate=9600"

# Disable splash screen
DISABLE_SPLASH = "1"
DISABLE_RPI_BOOT_LOGO = "1"

# Adding custom lines to /boot/config.txt
RPI_EXTRA_CONFIG = "\n\
dtoverlay=disable-bt\n\
dtoverlay=spi1-3cs\n\
dtoverlay=mcp2515-can2,oscillator=10000000,spimaxfrequency=1000000,interrupt=25\n\
"

# Adding mcp2515-can2.dtbo file to boot partition 
IMAGE_BOOT_FILES += "mcp2515-can2.dtbo;overlays/mcp2515-can2.dtbo"

# Adding out-of-tree kernel modules
MACHINE_ESSENTIAL_EXTRA_RDEPENDS += "kernel-module-linux-lin"

# Adding in-tree kernel device tree overlays
KERNEL_DEVICETREE:append = " overlays/spi1-3cs.dtbo"
```
